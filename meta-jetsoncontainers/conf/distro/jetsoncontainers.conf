## meta-jetsoncontainers/conf/distro/jetsoncontainers.conf
```bitbake
DISTRO = "jetsoncontainers" 
DISTRO_NAME = "jetsoncontainers (Jetson Docker Containers)" 
DISTRO_VERSION = "1.0" 
DISTRO_CODENAME = "jc" 
SDK_VENDOR = "-jcsdk" 
SDK_VERSION := "${@'${DISTRO_VERSION}'.replace('snapshot-${DATE}','snapshot')}" 

MAINTAINER = "jetsoncontainers <ashwoods@gmail.com>" 

DISTRO_FEATURES_remove = "x11" 


include conf/machine/${MACHINE}-extra.conf
require conf/distro/poky.conf 
```

## meta-jetsoncontainers/conf/layer.conf
```bitbake
BBPATH =. "${LAYERDIR}:"
BBFILES += "${LAYERDIR}/recipes-*/*/*.bb ${LAYERDIR}/recipes-*/*/*.bbappend"

BBFILE_COLLECTIONS += "jetsoncontainers"
BBFILE_PATTERN_jetsoncontainers = "^${LAYERDIR}/"
BBFILE_PRIORITY_jetsoncontainers = "50"

LAYERVERSION_jetsoncontainers = "1"
LAYERSERIES_COMPAT_jetsoncontainers = "dunfell"

# This is used by the tegra-distro-sanity bbclass
# to identify the distro layer directory during
# bblayers checks.
TD_DISTRO_LAYERDIR = "${LAYERDIR}"
```

## meta-jetsoncontainers/wic/jetson-tx2.wks
```
# short-description: Create SD card image
# long-description: Creates an SD card image with a single EXT4 partition for FS.

part / --source rootfs --ondisk mmcblk2 --fstype=ext4 --label root --align 4
```
